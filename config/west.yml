## config/west.yml
```yaml
manifest:
  remotes:
    - name: zmkfirmware
      url-base: https://github.com/zmkfirmware
    - name: cobowers
      url-base: https://github.com/cobowers
    - name: ftc
      url-base: https://github.com/ftc
  projects:
    #- name: zmk
    #  remote: ftc
    #  revision: mouse-ftc
    #  import: app/west.yml
    - name: zmk
      remote: cobowers
      revision: cobowers-mouse-ftc
      import: app/west.yml
  self:
    path: config
```
